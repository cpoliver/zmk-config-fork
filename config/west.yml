## config/west.yml
```yaml
manifest:
  defaults:
    remote: urob
    revision: main

  remotes:
    - name: upstream
      url-base: https://github.com/zmkfirmware
    - name: urob
      url-base: https://github.com/urob
    - name: m165437
      url-base: https://github.com/M165437

  projects:
    - name: zmk
      remote: urob
      revision: main-3.5
      import: app/west.yml

    - name: nice-view-gem
      remote: m165437
      revision: main

    - name: zmk-auto-layer
      path: modules/auto-layer

    - name: zmk-helpers
      path: modules/helpers

    - name: zmk-leader-key
      path: modules/leader-key

    - name: zmk-tri-state
      path: modules/tri-state

  self:
    path: config
```
